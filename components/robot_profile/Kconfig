## components/robot_profile/Kconfig
```kconfig
choice BOTFARMS_ROBOT_PROFILE
    prompt "BotFarms robot build profile"
    default BOTFARMS_PROFILE_CURRENT_ROBOT

config BOTFARMS_PROFILE_CURRENT_ROBOT
    bool "Current robot (two dual-channel SVD48 devices)"

config BOTFARMS_PROFILE_BENCH_SINGLE_SVD48_MOTOR
    bool "Bench single SVD48 motor"

config BOTFARMS_PROFILE_BENCH_SINGLE_STEERING_AS5600
    bool "Bench single steering axis with AS5600 feedback"

config BOTFARMS_PROFILE_RAFA
    bool "Rafa sprayer (one dual-channel SVD48 and PPM RC)"
endchoice

config BOTFARMS_RAFA_LAN_ONLY_DIAGNOSTIC
    bool "Temporary Rafa LAN-only authority diagnostic"
    depends on BOTFARMS_PROFILE_RAFA
    default n
    help
        Keep PPM decoding available for read-only receiver diagnostics, but do
        not start the PPM motion source or let the RC/LAN interlock arbitrate
        continuous control. LAN remains subject to its normal 300 ms profile
        TTL, deadman, STOP and SVD/motor-fault safety paths. This is a
        build-selected diagnostic mode, not a runtime command; rebuild Rafa
        without this option after the comparison.

choice BOTFARMS_RAFA_WEB_JOYSTICK_EXPERIMENT_MODE
    prompt "Rafa temporary direct web joystick experiment"
    depends on BOTFARMS_PROFILE_RAFA && !BOTFARMS_RAFA_LAN_ONLY_DIAGNOSTIC
    default BOTFARMS_RAFA_WEB_JOYSTICK_EXPERIMENT_NONE

config BOTFARMS_RAFA_WEB_JOYSTICK_EXPERIMENT_NONE
    bool "None"

config BOTFARMS_RAFA_WEB_JOYSTICK_EXPERIMENTAL
    bool "Station-network direct ESP web joystick"
    help
        Serve an isolated direct-browser control UI from the ESP32 over the
        existing station network. PPM remains observation-only and UDP Control
        LAN is not started. Movement enters only as typed WEB_DIRECT semantic
        intent with the normal application, endpoint, SVD and safety owners.

config BOTFARMS_RAFA_SOFTAP_WEB_JOYSTICK_EXPERIMENTAL
    bool "SoftAP direct ESP web joystick"
    help
        Serve the isolated direct-browser joystick only through an ESP32
        SoftAP. This creates an AP interface only: it does not create a Wi-Fi
        station, use APSTA, read station credentials, or start reconnect.
        PPM remains observation-only and UDP Control LAN is not started. This
        is a build-selected diagnostic experiment; rebuild Rafa without this
        option to restore the normal profile.

endchoice

config BOTFARMS_RAFA_SOFTAP_PASSPHRASE
    string "Rafa SoftAP WPA2 passphrase (local build input)"
    depends on BOTFARMS_RAFA_SOFTAP_WEB_JOYSTICK_EXPERIMENTAL
    default ""
    help
        Required at build time for the experimental SoftAP. Supply a WPA2
        passphrase of 8 to 63 characters through an ignored local sdkconfig
        defaults file. Do not commit a real credential or place it in NVS.
```
